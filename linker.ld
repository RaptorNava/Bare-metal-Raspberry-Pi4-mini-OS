/**
 * linker.ld — Скрипт компоновщика для bare-metal AArch64 (Raspberry Pi 4)
 *
 * Карта памяти после загрузки:
 *   0x00000000 - 0x0007FFFF  Зарезервировано GPU/firmware (512 KB)
 *   0x00080000              _start: точка входа (kernel8.img загружается сюда)
 *   0x00080000 - 0x000FFFFF  .text.boot + .text + .rodata + .data
 *   [после .data]            __bss_start ... __bss_end  (обнуляется в boot.S)
 *   0x00200000 - 0x03EFFFFF  Куча ядра (memory.c)
 *   0x03F00000 - 0x3FFFFFFF  Зарезервировано / периферия (RPi3-совместимо)
 *   0xFC000000 - 0xFFFFFFFF  Периферия RPi4 (PERIPHERAL_BASE = 0xFE000000)
 */

ENTRY(_start)

SECTIONS
{
    /* ----------------------------------------------------------------
     * Точка загрузки: GPU помещает kernel8.img по адресу 0x80000
     * ---------------------------------------------------------------- */
    . = 0x80000;

    /* ----------------------------------------------------------------
     * .text.boot — код boot.S должен идти ПЕРВЫМ,
     * чтобы _start оказался ровно по адресу 0x80000.
     * ---------------------------------------------------------------- */
    .text.boot : {
        KEEP(*(.text.boot))
    }

    /* ----------------------------------------------------------------
     * .text — весь остальной исполняемый код
     * Выравниваем по 4 байтам (требование AArch64).
     * ---------------------------------------------------------------- */
    .text : ALIGN(4) {
        *(.text)
        *(.text.*)
    }

    /* ----------------------------------------------------------------
     * .rodata — константы только для чтения (строки, таблицы нот и т.п.)
     * ---------------------------------------------------------------- */
    .rodata : ALIGN(4) {
        *(.rodata)
        *(.rodata.*)
    }

    /* ----------------------------------------------------------------
     * .data — инициализированные глобальные переменные
     * ---------------------------------------------------------------- */
    .data : ALIGN(4) {
        *(.data)
        *(.data.*)
    }

    /* ----------------------------------------------------------------
     * .bss — неинициализированные глобальные переменные
     * boot.S обнуляет этот диапазон до вызова kernel_main().
     * NOLOAD — компоновщик не включает эти байты в образ файла.
     * ---------------------------------------------------------------- */
    .bss (NOLOAD) : ALIGN(16) {
        __bss_start = .;
        *(.bss)
        *(.bss.*)
        *(COMMON)
        __bss_end = .;
    }

    /* ----------------------------------------------------------------
     * Символ конца ядра — используется для проверки границ памяти
     * ---------------------------------------------------------------- */
    __kernel_end = .;

    /* ----------------------------------------------------------------
     * Отбрасываем отладочные и служебные секции GCC/LD,
     * которые не нужны в bare-metal образе.
     * ---------------------------------------------------------------- */
    /DISCARD/ : {
        *(.comment)
        *(.note*)
        *(.eh_frame*)
        *(.ARM.exidx*)
        *(.ARM.attributes)
    }
}
